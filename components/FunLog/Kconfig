## main/Kconfig.projbuild
```kconfig
menu "Toothless"
    choice TL_HARDWARE_IMPLEMENTATION
        prompt "Select the hardware implementation"
        config IMPL_LILYGO_TDISPLAY_S3_LONG
            bool "Lilygo T-Display S3 Long"
        config IMPL_WAVESHARE_TOUCH_LCD_4
            bool "Waveshare Touch LCD 4"
        config IMPL_CYB_4_3_INCH
            bool "Cheap Yellow Board 4.3inch Display"
        config IMPL_LILYGO_T_HMI
            bool "Lilygo T-HMI S3"
        config IMPL_M5DIAL
            bool "M5Stack Dial"
        config IMPL_WAVESHARE_35_RPI_G
            bool "Waveshare 3.5inch RPi (G)"
    endchoice  
    menu "Display Options"
        config TL_HAS_DISPLAY
            bool "Has a display"
            default y
        config TL_LVGL_STACK_SIZE
            depends on TL_HAS_DISPLAY
            int "LVGL Task Stack Size"
            default 16384
            help
                Stack size for the LVGL task in bytes.
    endmenu
    # choice FLOG_LEVEL
    #     bool "Default log verbosity"
    #     default FLOG_LEVEL_INFO
    #     help
    #         Set the default log verbosity level for the application.
    #     config FLOG_LEVEL_NONE
    #         bool "No output"
    #     config FLOG_LEVEL_ERROR
    #         bool "Error"
    #     config FLOG_LEVEL_WARN
    #         bool "Warning"
    #     config FLOG_LEVEL_INFO
    #         bool "Info"
    #     config FLOG_LEVEL_DEBUG
    #         bool "Debug"
    #     config FLOG_LEVEL_VERBOSE
    #         bool "Verbose"
    # endchoice
    # config FLOG_LEVEL
    #     int
    #     default 0 if FLOG_LEVEL_NONE
    #     default 1 if FLOG_LEVEL_ERROR
    #     default 2 if FLOG_LEVEL_WARN
    #     default 3 if FLOG_LEVEL_INFO
    #     default 4 if FLOG_LEVEL_DEBUG
    #     default 5 if FLOG_LEVEL_VERBOSE

endmenu
```
