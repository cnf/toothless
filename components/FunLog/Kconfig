## components/FunLog/Kconfig
```kconfig
menu FunLOG
  choice FLOG_LEVEL
    bool "Default log verbosity"
    default FLOG_LEVEL_INFO
    help
        Set the default log verbosity level for the application.
    config FLOG_LEVEL_NONE
        bool "No output"
    config FLOG_LEVEL_ERROR
        bool "Error"
    config FLOG_LEVEL_WARN
        bool "Warning"
    config FLOG_LEVEL_INFO
        bool "Info"
    config FLOG_LEVEL_DEBUG
        bool "Debug"
    config FLOG_LEVEL_VERBOSE
        bool "Verbose"
  endchoice
  config FLOG_LEVEL
    int
    default 0 if FLOG_LEVEL_NONE
    default 1 if FLOG_LEVEL_ERROR
    default 2 if FLOG_LEVEL_WARN
    default 3 if FLOG_LEVEL_INFO
    default 4 if FLOG_LEVEL_DEBUG
    default 5 if FLOG_LEVEL_VERBOSE

endmenu
```

## components/display_waveshare_pi/Kconfig
```kconfig
menu "Display Impl: Waveshare Pi 3.5inch (G)"
  config IMPL_DISPLAY_HRES
      int "Display Horizontal Resolution"
      default 480
      help
          Horizontal resolution of the Waveshare 3.5inch RPi display.

  config IMPL_DISPLAY_VRES
      int "Display Vertical Resolution"
      default 320
      help
          Vertical resolution of the Waveshare 3.5inch RPi display.
  config IMPL_DISPLAY_BACKLIGHT_PIN
      int "Backlight Pin"
      default 4
      help
          GPIO pin connected to the display backlight control.

  config IMPL_DISPLAY_SPI_HOST
      int "SPI Host"
      default 1
      help
          SPI host to use for display communication.

  config IMPL_DISPLAY_SPI_CLK_PIN
      int "SPI Clock Pin"
      default 18

  config IMPL_DISPLAY_SPI_MOSI_PIN
      int "SPI MOSI Pin"
      default 23

  config IMPL_DISPLAY_SPI_MISO_PIN
      int "SPI MISO Pin"
      default 19

  config IMPL_DISPLAY_SPI_CS_PIN
      int "Display SPI CS Pin"
      default 5

  config IMPL_DISPLAY_DC_PIN
      int "Display Data/Command Pin"
      default 21

  config IMPL_DISPLAY_RESET_PIN
      int "Display Reset Pin"
      default 22

  config IMPL_DISPLAY_BACKLIGHT_PIN
      int "Display Backlight Pin"
      default 4

  config IMPL_TOUCHPANEL_SPI_CS_PIN
      int "Touchscreen SPI CS Pin"
      default 17

  config IMPL_TOUCHPANEL_INT_PIN
      int "Touchscreen Interrupt Pin"
      default 16

endmenu
```

## components/impl_cyb_4.3inch/Kconfig
```kconfig
menu "Display Impl: CYB 4.3inch"
    config IMPL_CYB_4_3_INCH_HRES
        int "Display Horizontal Resolution"
        default 800
        help
            Horizontal resolution of the CYB 4.3inch display.

    config IMPL_LCYB_4_3_INCH_VRES
        int "Display Vertical Resolution"
        default 480
        help
            Vertical resolution of the CYB 4.3inch display.
    menu "RGB LCD Config"
        config IMPL_LCYB_4_3_INCH_RGB_LCD_PIXEL_CLOCK_HZ
            int "RGB LCD Pixel Clock Hz (pclk)"
            default 9000000
        config IMPL_LCYB_4_3_INCH_RGB_LCD_DE_PIN
            int "RGB LCD DE Pin"
            default 40
        config IMPL_LCYB_4_3_INCH_RGB_LCD_VSYNC_PIN
            int "RGB LCD VSYNC Pin"
            default 41
        config IMPL_LCYB_4_3_INCH_RGB_LCD_HSYNC_PIN
            int "RGB LCD HSYNC Pin"
            default 39
        config IMPL_LCYB_4_3_INCH_RGB_LCD_PCLK_PIN
            int "RGB LCD PCLK Pin"
            default 42
        config IMPL_LCYB_4_3_INCH_RGB_LCD_R0_PIN
            int "RGB LCD R0 Pin"
            default 45
        config IMPL_LCYB_4_3_INCH_RGB_LCD_R1_PIN
            int "RGB LCD R1 Pin"
            default 48
        config IMPL_LCYB_4_3_INCH_RGB_LCD_R2_PIN
            int "RGB LCD R2 Pin"
            default 47
        config IMPL_LCYB_4_3_INCH_RGB_LCD_R3_PIN
            int "RGB LCD R3 Pin"
            default 21
        config IMPL_LCYB_4_3_INCH_RGB_LCD_R4_PIN
            int "RGB LCD R4 Pin"
            default 14
        config IMPL_LCYB_4_3_INCH_RGB_LCD_G0_PIN
            int "RGB LCD G0 Pin"
            default 5
        config IMPL_LCYB_4_3_INCH_RGB_LCD_G1_PIN
            int "RGB LCD G1 Pin"
            default 6
        config IMPL_LCYB_4_3_INCH_RGB_LCD_G2_PIN
            int "RGB LCD G2 Pin"
            default 7
        config IMPL_LCYB_4_3_INCH_RGB_LCD_G3_PIN
            int "RGB LCD G3 Pin"
            default 15
        config IMPL_LCYB_4_3_INCH_RGB_LCD_G4_PIN
            int "RGB LCD G4 Pin"
            default 16
        config IMPL_LCYB_4_3_INCH_RGB_LCD_G5_PIN
            int "RGB LCD G5 Pin"
            default 4
        config IMPL_LCYB_4_3_INCH_RGB_LCD_B0_PIN
            int "RGB LCD B0 Pin"
            default 8
        config IMPL_LCYB_4_3_INCH_RGB_LCD_B1_PIN
            int "RGB LCD B1 Pin"
            default 3
        config IMPL_LCYB_4_3_INCH_RGB_LCD_B2_PIN
            int "RGB LCD B2 Pin"
            default 46
        config IMPL_LCYB_4_3_INCH_RGB_LCD_B3_PIN
            int "RGB LCD B3 Pin"
            default 9
        config IMPL_LCYB_4_3_INCH_RGB_LCD_B4_PIN
            int "RGB LCD B4 Pin"
            default 1

 #   40 /* DE */,
 #     41 /* VSYNC */,
 #     39 /* HSYNC */,
 #     42 /* PCLK */,
 #     45 /* R0 */,
 #     48 /* R1 */,
 #     47 /* R2 */,
 #     21 /* R3 */,
 #     14 /* R4 */,
 #     5 /* G0 */,
 #     6 /* G1 */,
 #     7 /* G2 */,
 #     15 /* G3 */,
 #     16 /* G4 */,
 #     4 /* G5 */,
 #     8 /* B0 */,
 #     3 /* B1 */,
 #     46 /* B2 */,
 #     9 /* B3 */,
 #     1 /* B4 */
    endmenu
#     config IMPL_LCYB_4_3_INCH_SPI_HOST
#         int "SPI Host"
#         default 1
#         help
#             SPI host to use for display communication.

#     config IMPL_LCYB_4_3_INCH_QSPI_SCK_PIN
#         int "SPI Clock Pin"
#         default 17
#     config IMPL_LCYB_4_3_INCH_QSPI_RST_PIN
#         int "Display QSPI Reset Pin"
#         default 16
#     config IMPL_LCYB_4_3_INCH_QSPI_CS_PIN
#         int "Display SPI CS Pin"
#         default 12
#     config IMPL_LCYB_4_3_INCH_QSPI_D0_PIN
#         int "Display QSPI D0 Pin"
#         default 13
#     config IMPL_LCYB_4_3_INCH_QSPI_D1_PIN
#         int "Display QSPI D1 Pin"
#         default 18
#     config IMPL_LCYB_4_3_INCH_QSPI_D2_PIN
#         int "Display QSPI D2 Pin"
#         default 21
#     config IMPL_LCYB_4_3_INCH_QSPI_D3_PIN
#         int "Display QSPI D3 Pin"
#         default 14
    config IMPL_LCYB_4_3_INCH_BACKLIGHT_PIN
        int "Display Backlight Pin"
        default 2

    config IMPL_TOUCHPANEL_RESET_PIN
        int "Touchscreen Interrupt Pin"
        default 38

endmenu

# # config IMPL_I2C_SDA_PIN
# #     int
# #     default 15
# #     # depends on CONFIG_TL_DISPLAY_COMP_LG_TDISPLAY_S3_LONG
# #     # select IOM_I2C_SDA_PIN=15
# #     # set IOM_I2C_SCL_PIN=10
# # config IMPL_I2C_SCL_PIN
# #     int
# #     default 10
# #     # depends on CONFIG_TL_DISPLAY_COMP_LG_TDISPLAY_S3_LONG

config IOM_I2C_SDA_PIN
    int
    default 19
    depends on IMPL_LCYB_4_3_INCH

config IOM_I2C_SCL_PIN
    int
    default 20
    depends on IMPL_LCYB_4_3_INCH


#define TOUCH_GT911
#define TOUCH_GT911_SCL 20
#define TOUCH_GT911_SDA 19
#define TOUCH_GT911_INT -1
#define TOUCH_GT911_RST 38
#define TOUCH_GT911_ROTATION ROTATION_RIGHT  //ROTATION_NORMAL
#define TOUCH_MAP_X1 320
#define TOUCH_MAP_X2 0
#define TOUCH_MAP_Y1 240
#define TOUCH_MAP_Y2 0
```

## components/impl_cyb_4_3inch/Kconfig
```kconfig
menu "Display Impl: CYB 4.3inch"
    config IMPL_CYB_4_3_INCH_HRES
        int "Display Horizontal Resolution"
        default 800
        help
            Horizontal resolution of the CYB 4.3inch display.

    config IMPL_CYB_4_3_INCH_VRES
        int "Display Vertical Resolution"
        default 480
        help
            Vertical resolution of the CYB 4.3inch display.

 #   40 /* DE */,
 #     41 /* VSYNC */,
 #     39 /* HSYNC */,
 #     42 /* PCLK */,
 #     45 /* R0 */,
 #     48 /* R1 */,
 #     47 /* R2 */,
 #     21 /* R3 */,
 #     14 /* R4 */,
 #     5 /* G0 */,
 #     6 /* G1 */,
 #     7 /* G2 */,
 #     15 /* G3 */,
 #     16 /* G4 */,
 #     4 /* G5 */,
 #     8 /* B0 */,
 #     3 /* B1 */,
 #     46 /* B2 */,
 #     9 /* B3 */,
 #     1 /* B4 */


endmenu


config IOM_I2C_SDA_PIN
    int
    default 19
    depends on IMPL_CYB_4_3_INCH

config IOM_I2C_SCL_PIN
    int
    default 20
    depends on IMPL_CYB_4_3_INCH

config IOM_EXTERNAL_ENABLE
    bool
    default y
    depends on IMPL_CYB_4_3_INCH

config IOM_EXTERNAL_I2C_SDA_PIN
    int
    default 17
    depends on IMPL_CYB_4_3_INCH
    depends on IOM_EXTERNAL_ENABLE

config IOM_EXTERNAL_I2C_SCL_PIN
    int
    default 18
    depends on IMPL_CYB_4_3_INCH
    depends on IOM_EXTERNAL_ENABLE


#define TOUCH_GT911
#define TOUCH_GT911_SCL 20
#define TOUCH_GT911_SDA 19
#define TOUCH_GT911_INT -1
#define TOUCH_GT911_RST 38
#define TOUCH_GT911_ROTATION ROTATION_RIGHT  //ROTATION_NORMAL
#define TOUCH_MAP_X1 320
#define TOUCH_MAP_X2 0
#define TOUCH_MAP_Y1 240
#define TOUCH_MAP_Y2 0
```

## components/impl_lilygo_t_display_s3_long/Kconfig
```kconfig
menu "Display Impl: LilyGo T-Display S3 Long"
    config IMPL_LILYGO_TDISPLAY_S3_LONG_HRES
        int "Display Horizontal Resolution"
        default 640
        help
            Horizontal resolution of the Waveshare 3.5inch RPi display.

    config IMPL_LILYGO_TDISPLAY_S3_LONG_VRES
        int "Display Vertical Resolution"
        default 180
        help
            Vertical resolution of the Waveshare 3.5inch RPi display.

    config IMPL_LILYGO_TDISPLAY_S3_LONG_SPI_HOST
        int "SPI Host"
        default 1
        help
            SPI host to use for display communication.

endmenu


config IOM_I2C_SDA_PIN
    int
    default 15
    depends on IMPL_LILYGO_TDISPLAY_S3_LONG

config IOM_I2C_SCL_PIN
    int
    default 10
    depends on IMPL_LILYGO_TDISPLAY_S3_LONG
```

## components/impl_lilygo_t_hmi/Kconfig
```kconfig
menu "Display Impl: LilyGo T-HMI"
    config IMPL_LILYGO_T_HMI_HRES
        int "Display Horizontal Resolution"
        default 320
        help
            Horizontal resolution of the LilyGo T-HMI.

    config IMPL_LILYGO_T_HMI_VRES
        int "Display Vertical Resolution"
        default 240
        help
            Vertical resolution of the LilyGo T-HMI.

 #   40 /* DE */,
 #     41 /* VSYNC */,
 #     39 /* HSYNC */,
 #     42 /* PCLK */,
 #     45 /* R0 */,
 #     48 /* R1 */,
 #     47 /* R2 */,
 #     21 /* R3 */,
 #     14 /* R4 */,
 #     5 /* G0 */,
 #     6 /* G1 */,
 #     7 /* G2 */,
 #     15 /* G3 */,
 #     16 /* G4 */,
 #     4 /* G5 */,
 #     8 /* B0 */,
 #     3 /* B1 */,
 #     46 /* B2 */,
 #     9 /* B3 */,
 #     1 /* B4 */


endmenu


config IOM_I2C_SDA_PIN
    int
    default 15
    depends on IMPL_LILYGO_T_HMI

config IOM_I2C_SCL_PIN
    int
    default 16
    depends on IMPL_LILYGO_T_HMI
```

## components/impl_m5core2/Kconfig
```kconfig
menu "HW Implementation: M5 Basic"
    config IMPL_M5CORE2_HRES
        int "Display Horizontal Resolution"
        default 320
        help
            Horizontal resolution of the M5Stack Dial display.

    config IMPL_M5CORE2_VRES
        int "Display Vertical Resolution"
        default 240
        help
            Vertical resolution of the M5Stack Dial display.
endmenu



config IOM_I2C_SDA_PIN
    int
    default 32
    depends on IMPL_M5CORE2

config IOM_I2C_SCL_PIN
    int
    default 33
    depends on IMPL_M5CORE2
```

## components/impl_m5dial/Kconfig
```kconfig
menu "Display Impl: LilyGo T-Display S3 Long"
    config IMPL_M5DIAL_HRES
        int "Display Horizontal Resolution"
        default 240
        help
            Horizontal resolution of the M5Stack Dial display.

    config IMPL_M5DIAL_VRES
        int "Display Vertical Resolution"
        default 240
        help
            Vertical resolution of the M5Stack Dial display.
endmenu



config IOM_I2C_SDA_PIN
    int
    default 11
    depends on IMPL_M5DIAL

config IOM_I2C_SCL_PIN
    int
    default 12
    depends on IMPL_M5DIAL
```

## components/impl_waveshare_pi/Kconfig
```kconfig
menu "Display Impl: Waveshare Pi 3.5inch (G)"
    config IMPL_WSRPIG_HRES
        int "Display Horizontal Resolution"
        default 480
        help
            Horizontal resolution of the Waveshare 3.5inch RPi display.

    config IMPL_WSRPIG_VRES
        int "Display Vertical Resolution"
        default 320
        help
            Vertical resolution of the Waveshare 3.5inch RPi display.
    config IMPL_WSRPIG_BACKLIGHT_PIN
        int "Backlight Pin"
        default 4
        help
            GPIO pin connected to the display backlight control.

    config IMPL_WSRPIG_SPI_HOST
        int "SPI Host"
        default 1
        help
            SPI host to use for display communication.

    config IMPL_WSRPIG_SPI_CLK_PIN
        int "SPI Clock Pin"
        default 18

    config IMPL_WSRPIG_SPI_MOSI_PIN
        int "SPI MOSI Pin"
        default 23

    config IMPL_WSRPIG_SPI_MISO_PIN
        int "SPI MISO Pin"
        default 19

    config IMPL_WSRPIG_SPI_CS_PIN
        int "Display SPI CS Pin"
        default 5

    config IMPL_WSRPIG_DC_PIN
        int "Display Data/Command Pin"
        default 21

    config IMPL_WSRPIG_RESET_PIN
        int "Display Reset Pin"
        default 22

    config IMPL_TOUCHPANEL_SPI_CS_PIN
        int "Touchscreen SPI CS Pin"
        default 17

    config IMPL_TOUCHPANEL_INT_PIN
        int "Touchscreen Interrupt Pin"
        default 34
        #16

endmenu
```

## components/impl_waveshare_touch_lcd_4/Kconfig
```kconfig
menu "HW Implementation: Waveshare Touch LCD 4"
    config IMPL_WAVESHARE_TOUCH_LCD_4_HRES
        int "Display Horizontal Resolution"
        default 480
        help
            Horizontal resolution of the Waveshare Touch LCD 4.

    config IMPL_WAVESHARE_TOUCH_LCD_4_VRES
        int "Display Vertical Resolution"
        default 480
        help
            Vertical resolution of the Waveshare Touch LCD 4.


endmenu


config IOM_I2C_SDA_PIN
    int
    default 15
    depends on IMPL_WAVESHARE_TOUCH_LCD_4

config IOM_I2C_SCL_PIN
    int
    default 7
    depends on IMPL_WAVESHARE_TOUCH_LCD_4

# config IOM_EXTERNAL_ENABLE
#     bool
#     default y
#     depends on IMPL_WAVESHARE_TOUCH_LCD_4


# config IOM_EXTERNAL_I2C_SDA_PIN
#     int
#     default 15
#     depends on IOM_EXTERNAL_ENABLE

# config IOM_EXTERNAL_I2C_SCL_PIN
#     int
#     default 7
#     depends on IOM_EXTERNAL_ENABLE
```

## components/io_manager/Kconfig
```kconfig
menu "IO Manager Configuration"
    menu "I2C Configuration"
        config IOM_I2C_SDA_PIN
            int "I2C SDA Pin"
            default IMPL_I2C_SDA_PIN if IMPL_I2C_SDA_PIN
            # if CONFIG_IMPL_I2C_SDA_PIN
            default 21
        config IOM_I2C_SCL_PIN
            int "I2C SCL Pin"
            default IMPL_I2C_SCL_PIN if IMPL_I2C_SDA_PIN
            default 22
        config IOM_I2C_FREQUENCY
            int "I2C Frequency (Hz)"
            default 400000
        config IOM_INTERNAL_ENABLE
            bool "Enable Internal I2C Bus"
            default n
        config IOM_INTERNAL_I2C_SDA_PIN
            depends on IOM_INTERNAL_ENABLE
            int "Internal I2C SDA Pin"
            default 18
        config IOM_INTERNAL_I2C_SCL_PIN
            depends on IOM_INTERNAL_ENABLE
            int "Internal I2C SCL Pin"
            default 19
        config IOM_INTERNAL_I2C_FREQUENCY
            depends on IOM_INTERNAL_ENABLE
            int "Internal I2C Frequency (Hz)"
            default 400000
    endmenu
endmenu

config IOM_I2C_SDA_PIN_OVERRIDE
    depends on IMPL_I2C_SDA_PIN
    bool
```

## config/sdkconfig.defaults
```kconfig
CONFIG_APP_COMPILE_TIME_DATE=y

CONFIG_BOOTLOADER_LOG_LEVEL_WARN=y

CONFIG_COMPILER_WARN_WRITE_STRINGS=y
CONFIG_COMPILER_OPTIMIZATION_ASSERTIONS_ENABLE=y
CONFIG_CU_GCC_LTO_ENABLE=y
CONFIG_COMPILER_OPTIMIZATION_PERF=y

CONFIG_IO_EXPANDER_ENABLE_GPIO_API_WRAPPER=y
```
